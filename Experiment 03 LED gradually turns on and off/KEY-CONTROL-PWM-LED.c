/*********************************************************************************
* 【编写时间】： 2014年3月5日
* 【作    者】： 清翔电子:03
* 【版    本】： 1.0
* 【网    站】： http://www.qxmcu.com/ 
* 【淘宝店铺】： http://qxmcu.taobao.com/ (直销店)  http://qx-mcu.taobao.com/  （总店）
* 【实验平台】： QX-MCS51 单片机开发板
* 【外部晶振】： 11.0592mhz	
* 【主控芯片】： STC89C52RC
* 【编译环境】： Keil μVisio4	
* 【程序功能】： 			   			            			    
* 【使用说明】： 实验前请接上J1与J2跳线帽
				 利用定时器控制产生占空比可变的 PWM 波
				 按S1，PWM值增加，则占空比减小,LED 灯渐亮
				 按S2，PWM值减小，则占空比增加,LED 灯渐暗
				 当PWM值增加到最大值或减小到最小值时，蜂鸣器将报警 
**********************************************************************************/

#include<reg51.h>
#include<intrins.h>

sbit  K1 =P3^4 ;           //PWM值增加键
sbit  K2 =P3^5;           //PWM值减少键
sbit  BEEP =P3^6;         //蜂鸣器
unsigned char PWM=0x7f ;   //赋初值

void Beep();
void delayms(unsigned char ms);
void delay(unsigned char t);

/*********************************************************/
void main()
{   
    P1=0xff;
    TMOD=0x21 ;
	TH0=0xfc ;           //1ms延时常数
    TL0=0x66 ;           //频率调节

    TH1=PWM ;            //脉宽调节
    TL1=0 ;

	EA=1;
	ET0=1;
	ET1=1;
    
    TR0=1 ;

   while(1)
   {
	do{
	    if(PWM!=0xff)
		  {PWM++ ;delayms(10);}
        else Beep() ; 
	  }
    while(K1==0);

	do{
      if(PWM!=0x02)
	    {PWM-- ;delayms(10);}
      else Beep() ; 
	  }
    while(K2==0);
  }
}

/*********************************************************/
// 定时器0中断服务程序  （频率）
/*********************************************************/
void timer0() interrupt 1 
{  
    TR1=0 ;
    TH0=0xfc ;
    TL0=0x66 ;
    TH1=PWM ;
    TR1=1 ;
    P1=0x00 ;      //启动输出
}

/*********************************************************/
// 定时器1中断服务程序 （脉宽）
/*********************************************************/
void timer1() interrupt 3 
{ 
    TR1=0 ;
    P1=0xff ;     //结束输出
}

/*********************************************************/
//蜂鸣器子程序
/*********************************************************/

void Beep()     
  {
    unsigned char i  ;
    for (i=0  ;i<100  ;i++)
      {
        delay(100)  ;
        BEEP=!BEEP  ;                //Beep取反
      } 
    BEEP=1  ;                        //关闭蜂鸣器
	delayms(100);
  } 

/*********************************************************/
// 延时子程序
/*********************************************************/  
void delay(unsigned char t)
 { 
   while(t--)   ;
 }

/*********************************************************/
// 延时子程序
/*********************************************************/
void delayms(unsigned char ms) 

{
   unsigned char i ;
   while(ms--)
    {
      for(i = 0 ; i < 120 ; i++) ;
    }
}

/*********************************************************/
