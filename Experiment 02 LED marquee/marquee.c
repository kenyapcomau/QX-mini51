/*********************************************************************************
* 【编写时间】： 2014年3月5日
* 【作    者】： 清翔电子:03
* 【版    本】： 1.0
* 【网    站】： http://www.qxmcu.com/ 
* 【淘宝店铺】： http://qxmcu.taobao.com/ (直销店)  http://qx-mcu.taobao.com/  （总店）
* 【实验平台】： QX-MCS51 单片机开发板
* 【外部晶振】： 11.0592mhz	
* 【主控芯片】： STC89C52RC
* 【编译环境】： Keil μVisio4	
* 【程序功能】： 流水灯测试			   			            			    
* 【使用说明】： 注意先用跳线冒将J2短接，使用跑马灯模块
**********************************************************************************/

#include<reg52.h>    //包含单片机寄存器的头文件

#define uchar unsigned char
#define uint unsigned int

/* 函数申明 -----------------------------------------------*/
void delay(uint z);

/*
********************************************************************************
** 函数名称 ： main(void)
** 函数功能 ： 主函数
********************************************************************************
*/
void main()
{
	uchar  num,dat1,dat2;
	delay(500);
	P0=0;
	while(1)
	{
		dat1=0xfe;
		dat2=0x7f;
		for(num=0;num<7;num++)
		{
			P1=dat1;	  //初始化赋值
			dat1=dat1<<1; //右移一位
			delay(500);   //延时	
		} 
		for(num=0;num<7;num++)
		{
			P1=dat2;	  //初始化赋值
			dat2=dat2>>1; //右移一位
			delay(500);   //延时	
		}
	}
}

/*
********************************************************************************
** 函数名称 ： delay(uint z)
** 函数功能 ： 延时函数
********************************************************************************
*/
void delay(uint z)
{
    uchar j;
    for(z;z>0;z--)
        for(j=200;j>0;j--);
}