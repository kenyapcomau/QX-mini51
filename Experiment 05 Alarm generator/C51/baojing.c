/*********************************************************************************
* 【编写时间】： 2014年3月5日
* 【作    者】： 清翔电子:03
* 【版    本】： 1.0
* 【网    站】： http://www.qxmcu.com/ 
* 【淘宝店铺】： http://qxmcu.taobao.com/ (直销店)  http://qx-mcu.taobao.com/  （总店）
* 【实验平台】： QX-MCS51 单片机开发板
* 【外部晶振】： 11.0592mhz	
* 【主控芯片】： STC89C52RC
* 【编译环境】： Keil μVisio4	
* 【程序功能】： 蜂鸣器测试-报警			   			            			    
* 【使用说明】： 短接蜂鸣器J1跳帽
**********************************************************************************/

#include <reg51.h>
#include <intrins.h>

#define uchar unsigned char
#define uint  unsigned int

sbit  BEEP=P3^6;

/*********************************************************
 500us延时函数
 晶振：11.0592MHz
*********************************************************/
void delay500(void)
{
  uchar  i;
  for(i=230;i>0;i--);
}

/*********************************************************
 主函数
*********************************************************/
main()
{
  uchar j;
  while(1)
  {
    for(j=200;j>0;j--)
	{
	  BEEP=~BEEP;       //输出频率1KHz
	  delay500();       //延时500us
	}

	for(j=200;j>0;j--)
	{
	  BEEP=~BEEP;       //输出频率500Hz
	  delay500();       //延时1ms
	  delay500();
	}
  }
}

/*********************************************************

信号产生的方法
500Hz信号周期为2ms，信号电平为每1ms变反1次。
1KHz 信号周期为1ms，信号电平每500us变反1次。

**********************************************************/
